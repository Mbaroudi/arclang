## src/compiler/embedded/targets/zephyr/litex_vexriscv/arclang_module/Kconfig
```kconfig
config CAN_ARCLANG_LITEX_SJA1000
	bool "SJA1000-compatible CAN core on a LiteX bus"
	default y
	depends on DT_HAS_ARCLANG_LITEX_SJA1000_ENABLED
	depends on CAN
	select CAN_SJA1000
	help
	  The front end of Zephyr's SJA1000 driver for an SJA1000-compatible
	  core on the SoC bus, one register per 32-bit word.

config ADC_ARCLANG_LITEX
	bool "ADC register bank of ArcLang's LiteX target"
	default y
	depends on DT_HAS_ARCLANG_LITEX_ADC_ENABLED
	depends on ADC
	help
	  One 32-bit read-only register per channel holding the last raw
	  conversion.
```

## src/compiler/embedded/targets/zephyr/litex_vexriscv/arclang_module/dts/bindings/arclang,litex-adc.yaml
```yaml
description: ADC register bank of ArcLang's LiteX target, one 32-bit read-only register per channel

compatible: "arclang,litex-adc"

include: [adc-controller.yaml]

properties:
  reg:
    required: true
  channels:
    type: int
    required: true
    description: Number of channels (registers).

io-channel-cells:
  - input
```

## src/compiler/embedded/targets/zephyr/litex_vexriscv/arclang_module/dts/bindings/arclang,litex-sja1000.yaml
```yaml
description: SJA1000-compatible CAN controller on a LiteX bus, one register per 32-bit word

compatible: "arclang,litex-sja1000"

include: [can-controller.yaml]

properties:
  reg:
    required: true
  interrupts:
    required: true
  clock-frequency:
    type: int
    required: true
    description: The controller's oscillator frequency (its core clock is half of it).
```
